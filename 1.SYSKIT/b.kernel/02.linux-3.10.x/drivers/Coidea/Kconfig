## 1.SYSKIT/b.kernel/02.linux-3.10.x/drivers/Coidea/qgpio/Kconfig
```kconfig
config qgpio

tristate"qgpio"

default y

---help---

  Say 'Y' here, it will be compiled into thekernel;and qlqc.taobao.com.
```
